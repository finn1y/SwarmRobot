## c_agent/main/Kconfig.projbuild
```kconfig
#Menu for user to provide WiFi and MQTT credentials
menu "Credentials config"

    config WIFI_SSID
        string "WiFi SSID"
        default "myssid"
        help
            SSID (network name) for the example to connect to.

    config WIFI_PASSWORD
        string "WiFi Password"
        default "mywifipassword"
        help
            WiFi password (WPA or WPA2).

    config WIFI_MAX_RETRY
        int "Max number of retries to connect to WiFi"
        default 4
        help
            Max number of retries to connect to WiFi.

    config MQTT_URI
        string "MQTT URI"
        default "mymqtturi"
        help
            URI of MQTT broker usually mqtt(s)://host:port.

    config MQTT_USERNAME
        string "MQTT Username"
        default "mymqttusername"
        help
            Username used to connect to MQTT broker with.

    config MQTT_PASSWORD
        string "MQTT Password"
        default "mymqttpassword"
        help
            Password used to connect to MQTT broker with.

endmenu

#Menu for user to provide pin mapping for ultrasonic senor and motor driver
menu "GPIO pin conf"

    config ULTRASONIC_SENSOR_TRIG
        int "GPIO pin ultrasonic sensor trigger pin is connected to"
        default 18
        help
            GPIO pin ultrasonic sensor trigger pin is connected to

    config ULTRASONIC_SENSOR_ECHO
        int "GPIO pin ultrasonic sensor echo pin is connected to"
        default 5
        help
            GPIO pin ultrasonic sensor echo pin is connected to

    config MOTOR_DRIVER_IN1
        int "GPIO pin motor driver in 1 pin is connected to"
        default 12
        help
            GPIO pin motor driver in 1 pin is connected to

    config MOTOR_DRIVER_IN2
        int "GPIO pin motor driver in 2 pin is connected to"
        default 13 
        help
            GPIO pin motor driver in 2 pin is connected to

    config MOTOR_DRIVER_IN3
        int "GPIO pin motor driver in 3 pin is connected to"
        default 21
        help
            GPIO pin motor driver in 3 pin is connected to

    config MOTOR_DRIVER_IN4
        int "GPIO pin motor driver in 4 pin is connected to"
        default 22
        help
            GPIO pin motor driver in 4 pin is connected to

endmenu
```
